## CMakeLists.txt
```
#
# Copyright (c) 2023 Nordic Semiconductor ASA
#
# SPDX-License-Identifier: LicenseRef-Nordic-5-Clause
#
cmake_minimum_required(VERSION 3.20.0)

find_package(Zephyr REQUIRED HINTS $ENV{ZEPHYR_BASE})
project(DimmerWithSerial)

# NORDIC SDK APP START
target_sources(app PRIVATE
  src/main.c
  src/model_handler.c
  src/serial_cmd.c
  src/usb_cdc_line_state.c
)
target_include_directories(app PRIVATE include)

# NORDIC SDK APP END
```

## sample.yaml
```
sample:
  description: Bluetooth Mesh dimmer with serial shell
  name: DimmerWithSerial
tests:
  sample.bluetooth.mesh.light_dimmer:
    sysbuild: true
    build_only: true
    integration_platforms:
      - nrf52dk/nrf52832
      - nrf52840dk/nrf52840
      - nrf52833dk/nrf52833
      - nrf5340dk/nrf5340/cpuapp
      - nrf5340dk/nrf5340/cpuapp/ns
      - thingy53/nrf5340/cpuapp
      - nrf21540dk/nrf52840
      - nrf52840dongle/nrf52840
      - nrf52840dongle/nrf52840/bare
      - nrf54l15dk/nrf54l15/cpuapp
      - nrf54l15dk/nrf54l10/cpuapp
      - nrf54l15dk/nrf54l05/cpuapp
      - nrf54lm20dk/nrf54lm20a/cpuapp
    platform_allow:
      - nrf52dk/nrf52832
      - nrf52840dk/nrf52840
      - nrf5340dk/nrf5340/cpuapp
      - nrf5340dk/nrf5340/cpuapp/ns
      - thingy53/nrf5340/cpuapp
      - nrf21540dk/nrf52840
      - nrf52833dk/nrf52833
      - nrf52840dongle/nrf52840
      - nrf52840dongle/nrf52840/bare
      - nrf54l15dk/nrf54l15/cpuapp
      - nrf54l15dk/nrf54l10/cpuapp
      - nrf54l15dk/nrf54l05/cpuapp
      - nrf54lm20dk/nrf54lm20a/cpuapp
    tags:
      - bluetooth
      - ci_build
      - sysbuild
  sample.bluetooth.mesh.light_dimmer.settings_ext_flash:
    sysbuild: true
    build_only: true
    integration_platforms:
      - nrf52840dk/nrf52840
      - nrf54l15dk/nrf54l15/cpuapp
      - nrf54l15dk/nrf54l10/cpuapp
      - nrf54l15dk/nrf54l05/cpuapp
    platform_allow:
      - nrf52840dk/nrf52840
      - nrf54l15dk/nrf54l15/cpuapp
      - nrf54l15dk/nrf54l10/cpuapp
      - nrf54l15dk/nrf54l05/cpuapp
    extra_args: FILE_SUFFIX=settings_ext_flash
    tags:
      - bluetooth
      - ci_build
      - sysbuild
```

## prj.conf
```kconfig
#
# Copyright (c) 2023 Nordic Semiconductor ASA
#
# SPDX-License-Identifier: LicenseRef-Nordic-5-Clause
#
CONFIG_NCS_SAMPLES_DEFAULTS=y

# Deferred logging helps improve LPN power consumption
# when friendship is established.
CONFIG_LOG_MODE_DEFERRED=y

# General configuration
CONFIG_NCS_APPLICATION_BOOT_BANNER_STRING="DimmerWithSerial"
CONFIG_SYSTEM_WORKQUEUE_STACK_SIZE=2048
CONFIG_FLASH=y
CONFIG_FLASH_MAP=y
CONFIG_NVS=y
CONFIG_SETTINGS=y
CONFIG_NVS_LOOKUP_CACHE=y
CONFIG_SETTINGS_NVS_NAME_CACHE=y
CONFIG_HWINFO=y
CONFIG_DK_LIBRARY=y
CONFIG_PM_PARTITION_SIZE_SETTINGS_STORAGE=0x8000
CONFIG_SOC_FLASH_NRF_PARTIAL_ERASE=y

# Bluetooth configuration
CONFIG_BT=y
CONFIG_BT_DEVICE_NAME="DimmerWithSerial"
CONFIG_BT_L2CAP_TX_BUF_COUNT=8
CONFIG_BT_OBSERVER=y
CONFIG_BT_PERIPHERAL=y
CONFIG_BT_SETTINGS=y

# Disable unused Bluetooth features
CONFIG_BT_CTLR_LE_ENC=n
CONFIG_BT_PHY_UPDATE=n
CONFIG_BT_CTLR_CHAN_SEL_2=n
CONFIG_BT_CTLR_MIN_USED_CHAN=n
CONFIG_BT_CTLR_PRIVACY=n

# Bluetooth Mesh configuration
CONFIG_BT_MESH=y
CONFIG_BT_MESH_RELAY=y
CONFIG_BT_MESH_FRIEND=y
CONFIG_BT_MESH_TX_SEG_MAX=32
CONFIG_BT_MESH_PB_GATT=y
CONFIG_BT_MESH_GATT_PROXY=y
CONFIG_BT_MESH_PROXY_USE_DEVICE_NAME=y
CONFIG_BT_MESH_DK_PROV=y
CONFIG_BT_MESH_NLC_PERF_DIMMING_CONTROL=y
CONFIG_BT_MESH_NLC_PERF_SCENE_SELECTOR=y
# Enabling NLC Dimming Control profile enables support for 3 application keys by
# default. Therefore, allow up to 3 application key bindings per model instance.
CONFIG_BT_MESH_MODEL_KEY_COUNT=3

# Bluetooth Mesh models
CONFIG_BT_MESH_LVL_CLI=y
CONFIG_BT_MESH_ONOFF_CLI=y
CONFIG_BT_MESH_SCENE_CLI=y

# Debugging
CONFIG_BT_MESH_LOG_LEVEL_DBG=y

# Serial command interface via Zephyr shell.
# CONFIG_SHELL_BACKEND_SERIAL routes to the physical UART on nRF54L15 DK
# (USB-C connector), and is redirected to USB CDC ACM on nRF52840 boards
# via CONFIG_BOARD_SERIAL_BACKEND_CDC_ACM in the board-specific conf files.
CONFIG_SHELL=y
CONFIG_SHELL_BACKEND_SERIAL=y
CONFIG_SHELL_CMD_BUFF_SIZE=128
```

## boards/nrf52840dongle_nrf52840_bare.conf
```kconfig
#
# Copyright (c) 2026
#
# SPDX-License-Identifier: LicenseRef-Nordic-5-Clause
#

# Board overlay for nRF52840 Dongle flashed via SWD (no nRF5 USB bootloader).
# Enables the Zephyr shell over USB CDC ACM on the dongle's USB port.
# SHELL_BACKEND_SERIAL_INIT_PRIORITY=51 must be lower than the SYS_INIT
# priority in usb_cdc_line_state.c (52), so the shell backend is ready before
# the line state handler registers its callback.

CONFIG_BOARD_SERIAL_BACKEND_CDC_ACM=y
CONFIG_SHELL_BACKEND_SERIAL_INIT_PRIORITY=51
CONFIG_USBD_CDC_ACM_WORKQUEUE=y
CONFIG_USBD_CDC_ACM_STACK_SIZE=2048
CONFIG_UDC_BUF_POOL_SIZE=16384
CONFIG_CDC_ACM_SERIAL_MANUFACTURER_STRING="Nordic Semiconductor ASA"
CONFIG_CDC_ACM_SERIAL_PRODUCT_STRING="DimmerWithSerial"
```

## include/model_handler.h
```c
/*
 * Copyright (c) 2023 Nordic Semiconductor ASA
 *
 * SPDX-License-Identifier: LicenseRef-Nordic-5-Clause
 */

/**
 * @file
 * @brief Model handler
 */

#ifndef MODEL_HANDLER_H__
#define MODEL_HANDLER_H__

#include <stdbool.h>
#include <stdint.h>
#include <zephyr/bluetooth/mesh.h>

#ifdef __cplusplus
extern "C" {
#endif

const struct bt_mesh_comp *model_handler_init(void);
int model_handler_onoff_set(bool turn_on);
int model_handler_dim_step(bool dim_up, uint8_t percent);

#ifdef __cplusplus
}
#endif

#endif /* MODEL_HANDLER_H__ */
```

## src/model_handler.c
```c
/*
 * Copyright (c) 2023 Nordic Semiconductor ASA
 *
 * SPDX-License-Identifier: LicenseRef-Nordic-5-Clause
 */

/**
 * @file
 * @brief Model handler for the Light Dimmer Controller.
 *
 */
#include <zephyr/bluetooth/bluetooth.h>
#include <zephyr/bluetooth/mesh/proxy.h>
#include <zephyr/sys/util.h>
#include <bluetooth/mesh/models.h>
#include <dk_buttons_and_leds.h>
#include "model_handler.h"
#include <time.h>

#include <zephyr/logging/log.h>
LOG_MODULE_REGISTER(dimmer_sample, LOG_LEVEL_INF);

#define SHORT_PRESS_THRESHOLD_MS 300
#define LONG_PRESS_TIMEOUT_SEC K_SECONDS(20)
#define DELTA_MOVE_STEP 1000
#define SCENE_COUNT 4

enum dim_direction { DIM_DOWN, DIM_UP };

/** Context for a single Light Dimmer instance. */
struct dimmer_ctx {
	/** Generic OnOff client instance for this switch */
	struct bt_mesh_onoff_cli onoff_client;
	/** Generic Level client instance for this switch */
	struct bt_mesh_lvl_cli lvl_client;
	/* Relative start time of the latest press of the button */
	int64_t press_start_time;
	/* Dimmer direction */
	enum dim_direction direction;
	/* Long press work (Dimmer mode) */
	struct k_work_delayable long_press_start_work;
	struct k_work_delayable long_press_stop_work;
};

/** Context for a single scene button instance */
struct scene_btn_ctx {
	/** Scene client instance for this button */
	struct bt_mesh_scene_cli client;
	/** The currently recalled scene*/
	uint16_t current_scene;
	/** Time when button was pressed */
	int64_t press_start_time;
};

#if IS_ENABLED(CONFIG_BT_MESH_NLC_PERF_BASELINE)
static const uint8_t cmp2_elem_offset[1] = { 0 };

static const struct bt_mesh_comp2_record comp_rec[2] = {
	{/* Basic Scene Selector NLC Profile 1.0.1*/
	.id = BT_MESH_NLC_PROFILE_ID_BASIC_SCENE_SELECTOR,
	.version.x = 1,
	.version.y = 0,
	.version.z = 1,
	.elem_offset_cnt = 1,
	.elem_offset = cmp2_elem_offset,
	.data_len = 0
	},
	{/* Dimming Control NLC Profile 1.0.1 */
	.id = BT_MESH_NLC_PROFILE_ID_DIMMING_CONTROL,
	.version.x = 1,
	.version.y = 0,
	.version.z = 1,
	.elem_offset_cnt = 1,
	.elem_offset = cmp2_elem_offset,
	.data_len = 0
	}
};

static const struct bt_mesh_comp2 comp_p2 = {
	.record_cnt = 2,
	.record = comp_rec
};
#endif

static void dimmer_start(struct k_work *work)
{
	struct dimmer_ctx *ctx = CONTAINER_OF(k_work_delayable_from_work(work), struct dimmer_ctx,
					      long_press_start_work);

	struct bt_mesh_lvl_move_set move_set = {
		.delta = (ctx->direction == DIM_UP) ? DELTA_MOVE_STEP :
						      (int16_t)(-1 * DELTA_MOVE_STEP),
		.transition = &(struct bt_mesh_model_transition){ .time = 500 },
	};

	LOG_INF("Start dimming %s...", (ctx->direction == DIM_UP ? "UP" : "DOWN"));

	/* As we can't know how many nodes are in a group, it doesn't
	 * make sense to send acknowledged messages to group addresses.
	 */
	if (bt_mesh_model_pub_is_unicast(ctx->lvl_client.model)) {
		bt_mesh_lvl_cli_move_set(&ctx->lvl_client, NULL, &move_set, NULL);
	} else {
		bt_mesh_lvl_cli_move_set_unack(&ctx->lvl_client, NULL, &move_set);
	}

	k_work_reschedule(&ctx->long_press_stop_work, LONG_PRESS_TIMEOUT_SEC);
}

static void dimmer_stop(struct k_work *work)
{
	struct dimmer_ctx *ctx = CONTAINER_OF(k_work_delayable_from_work(work), struct dimmer_ctx,
					      long_press_stop_work);

	struct bt_mesh_lvl_move_set move_set = {
		.delta = 0,
		.transition = NULL,
	};

	if (bt_mesh_model_pub_is_unicast(ctx->lvl_client.model)) {
		bt_mesh_lvl_cli_move_set(&ctx->lvl_client, NULL, &move_set, NULL);
	} else {
		bt_mesh_lvl_cli_move_set_unack(&ctx->lvl_client, NULL, &move_set);
	}
}

static struct dimmer_ctx dimmer = {
	.lvl_client = BT_MESH_LVL_CLI_INIT(NULL),
	.onoff_client = BT_MESH_ONOFF_CLI_INIT(NULL),
	.press_start_time = 0,
	.direction = DIM_DOWN
};

static void dimmer_cancel_pending_work(void)
{
	k_work_cancel_delayable(&dimmer.long_press_start_work);
	k_work_cancel_delayable(&dimmer.long_press_stop_work);
}

/*
 * publish_onoff_set() and publish_delta_step() are extracted from the button
 * handler so they can be shared with the serial command interface in
 * serial_cmd.c. The serial API functions (model_handler_onoff_set() and
 * model_handler_dim_step()) call dimmer_cancel_pending_work() first to prevent
 * conflicting mesh messages if a button hold and a serial command race.
 */
static int publish_onoff_set(bool turn_on)
{
	struct bt_mesh_onoff_set set = {
		.on_off = turn_on,
	};

	if (bt_mesh_model_pub_is_unicast(dimmer.onoff_client.model)) {
		return bt_mesh_onoff_cli_set(&dimmer.onoff_client, NULL, &set, NULL);
	}

	return bt_mesh_onoff_cli_set_unack(&dimmer.onoff_client, NULL, &set);
}

static int publish_delta_step(bool dim_up, uint8_t percent)
{
	int32_t delta;
	struct bt_mesh_lvl_delta_set set;

	delta = DIV_ROUND_CLOSEST((int32_t)UINT16_MAX * percent, 100);
	if (!dim_up) {
		delta *= -1;
	}

	set = (struct bt_mesh_lvl_delta_set){
		.delta = delta,
		.new_transaction = true,
		.transition = NULL,
	};

	if (bt_mesh_model_pub_is_unicast(dimmer.lvl_client.model)) {
		return bt_mesh_lvl_cli_delta_set(&dimmer.lvl_client, NULL, &set, NULL);
	}

	return bt_mesh_lvl_cli_delta_set_unack(&dimmer.lvl_client, NULL, &set);
}

static void dimmer_button_handler(struct dimmer_ctx *ctx, bool pressed)
{
	int err;

	if (pressed) {
		ctx->direction = (ctx->direction == DIM_UP) ? DIM_DOWN : DIM_UP;

		ctx->press_start_time = k_uptime_get();
		err = k_work_reschedule(&ctx->long_press_start_work,
					K_MSEC(SHORT_PRESS_THRESHOLD_MS));

		if (err < 0) {
			LOG_ERR("Scheduling dimming to start failed: %d", err);
		}
	} else {
		if ((k_uptime_get() - ctx->press_start_time) >= SHORT_PRESS_THRESHOLD_MS) {
			/** Button was released after a long time.
			 * Stop dimming immediately.
			 */
			err = k_work_reschedule(&ctx->long_press_stop_work, K_NO_WAIT);

			if (err < 0) {
				LOG_INF("Scheduling dimming to stop failed: %d", err);
			}

		} else {
			/** Button was released after a short time.
			 * Cancel dimming operation and toggle light on/off.
			 */
			LOG_INF("Toggle light %s", (ctx->direction == DIM_UP ? "ON" : "OFF"));
			k_work_cancel_delayable(&ctx->long_press_start_work);

			err = publish_onoff_set(ctx->direction);

			if (err) {
				LOG_ERR("Failed to send OnOff set message: %d", err);
			}
		}
	}
}

static struct scene_btn_ctx scene_btn = {
	.current_scene = 1,
	.press_start_time = 0
};

static void scene_button_handler(struct scene_btn_ctx *ctx, bool pressed)
{
	if (pressed) {
		ctx->press_start_time = k_uptime_get();
	} else {
		int err;

		if (k_uptime_get() - ctx->press_start_time > SHORT_PRESS_THRESHOLD_MS) {
			/* Long press, store scene */
			LOG_INF("Storing scene %d", ctx->current_scene);
			err = bt_mesh_scene_cli_store_unack(&ctx->client, NULL,
							    ctx->current_scene);

			if (err) {
				LOG_ERR("Failed to send Scene Store message: %d", err);
			}
		} else {
			/* Short press, recall next scene */
			ctx->current_scene = (ctx->current_scene >= SCENE_COUNT) ?
					     1 : ctx->current_scene + 1;
			LOG_INF("Recalling scene %d", ctx->current_scene);
			err = bt_mesh_scene_cli_recall_unack(&ctx->client, NULL,
							     ctx->current_scene, NULL);

			if (err) {
				LOG_ERR("Failed to send Scene Recall message: %d", err);
			}
		}
	}
}

static void button_handler_cb(uint32_t pressed, uint32_t changed)
{
	if (!bt_mesh_is_provisioned()) {
		LOG_ERR("Node is not provisioned");
		return;
	}

	if (changed & BIT(0)) {
		dimmer_button_handler(&dimmer, pressed & BIT(0));
	}
	if (changed & BIT(1)) {
		scene_button_handler(&scene_btn, pressed & BIT(1));
	}
}

/* Set up a repeating delayed work to blink the DK's LEDs when attention is
 * requested.
 */
static struct k_work_delayable attention_blink_work;
static bool attention;

static void attention_blink(struct k_work *work)
{
	static int idx;
	const uint8_t pattern[] = {
#if DT_NODE_EXISTS(DT_ALIAS(sw0))
		BIT(0),
#endif
#if DT_NODE_EXISTS(DT_ALIAS(sw1))
		BIT(1),
#endif
#if DT_NODE_EXISTS(DT_ALIAS(sw2))
		BIT(2),
#endif
#if DT_NODE_EXISTS(DT_ALIAS(sw3))
		BIT(3),
#endif
	};

	if (attention) {
		dk_set_leds(pattern[idx++ % ARRAY_SIZE(pattern)]);
		k_work_reschedule(&attention_blink_work, K_MSEC(30));
	} else {
		dk_set_leds(DK_NO_LEDS_MSK);
	}
}

static void attention_on(const struct bt_mesh_model *mod)
{
	attention = true;
	k_work_reschedule(&attention_blink_work, K_NO_WAIT);
}

static void attention_off(const struct bt_mesh_model *mod)
{
	/* Will stop rescheduling blink timer */
	attention = false;
}

static const struct bt_mesh_health_srv_cb health_srv_cb = {
	.attn_on = attention_on,
	.attn_off = attention_off,
};

static struct bt_mesh_health_srv health_srv = {
	.cb = &health_srv_cb,
};

BT_MESH_HEALTH_PUB_DEFINE(health_pub, 0);

static struct bt_mesh_elem elements[] = {
	BT_MESH_ELEM(1,
		     BT_MESH_MODEL_LIST(BT_MESH_MODEL_CFG_SRV,
					BT_MESH_MODEL_HEALTH_SRV(&health_srv, &health_pub),
					BT_MESH_MODEL_ONOFF_CLI(&dimmer.onoff_client),
					BT_MESH_MODEL_LVL_CLI(&dimmer.lvl_client),
					BT_MESH_MODEL_SCENE_CLI(&scene_btn.client)),
		     BT_MESH_MODEL_NONE),
};

static const struct bt_mesh_comp comp = {
	.cid = CONFIG_BT_COMPANY_ID,
	.elem = elements,
	.elem_count = ARRAY_SIZE(elements),
};

int model_handler_onoff_set(bool turn_on)
{
	if (!bt_mesh_is_provisioned()) {
		return -EAGAIN;
	}

	dimmer_cancel_pending_work();
	return publish_onoff_set(turn_on);
}

int model_handler_dim_step(bool dim_up, uint8_t percent)
{
	if (!bt_mesh_is_provisioned()) {
		return -EAGAIN;
	}

	if ((percent == 0U) || (percent > 100U)) {
		return -EINVAL;
	}

	dimmer_cancel_pending_work();
	return publish_delta_step(dim_up, percent);
}

const struct bt_mesh_comp *model_handler_init(void)
{
#if IS_ENABLED(CONFIG_BT_MESH_NLC_PERF_BASELINE)
	if (bt_mesh_comp2_register(&comp_p2)) {
		printf("Failed to register comp2\n");
	}
#endif

	static struct button_handler button_handler = {
		.cb = button_handler_cb,
	};

	dk_button_handler_add(&button_handler);
	k_work_init_delayable(&attention_blink_work, attention_blink);
	k_work_init_delayable(&dimmer.long_press_start_work, dimmer_start);
	k_work_init_delayable(&dimmer.long_press_stop_work, dimmer_stop);

	return &comp;
}
```

## src/serial_cmd.c
```c
/*
 * Copyright (c) 2026
 *
 * SPDX-License-Identifier: LicenseRef-Nordic-5-Clause
 */

#include <errno.h>
#include <stdbool.h>
#include <stdlib.h>
#include <string.h>
#include <zephyr/shell/shell.h>

#include "model_handler.h"

#define DEFAULT_DIM_STEP_PERCENT 10U

static int command_status_report(const struct shell *sh, int err)
{
	if (!err) {
		return 0;
	}

	if (err == -EAGAIN) {
		shell_error(sh, "Node is not provisioned");
	} else if (err == -EINVAL) {
		shell_error(sh, "Invalid input");
	} else {
		shell_error(sh, "Command failed: %d", err);
	}

	return err;
}

static int parse_percent_arg(const struct shell *sh, const char *arg, uint8_t *percent)
{
	char *end;
	char percent_buf[5];
	unsigned long value;

	if (strlen(arg) >= sizeof(percent_buf)) {
		shell_error(sh, "Percentage must be in range 1-100");
		return -EINVAL;
	}

	strcpy(percent_buf, arg);
	end = strchr(percent_buf, '%');
	if (end != NULL) {
		if (*(end + 1) != '\0') {
			shell_error(sh, "Unexpected characters after %%");
			return -EINVAL;
		}
		*end = '\0';
	}

	value = strtoul(percent_buf, &end, 10);
	if ((*percent_buf == '\0') || (*end != '\0') || (value == 0U) || (value > 100U)) {
		shell_error(sh, "Percentage must be in range 1-100");
		return -EINVAL;
	}

	*percent = (uint8_t)value;
	return 0;
}

static int cmd_on(const struct shell *sh, size_t argc, char **argv)
{
	ARG_UNUSED(argc);
	ARG_UNUSED(argv);

	return command_status_report(sh, model_handler_onoff_set(true));
}

static int cmd_off(const struct shell *sh, size_t argc, char **argv)
{
	ARG_UNUSED(argc);
	ARG_UNUSED(argv);

	return command_status_report(sh, model_handler_onoff_set(false));
}

static int cmd_dim_common(const struct shell *sh, size_t argc, char **argv, bool dim_up)
{
	uint8_t percent = DEFAULT_DIM_STEP_PERCENT;
	int err;

	if (argc >= 2U) {
		err = parse_percent_arg(sh, argv[1], &percent);
		if (err) {
			return err;
		}
	}

	err = model_handler_dim_step(dim_up, percent);
	if (!err) {
		shell_print(sh, "Dim %s by %u%%", dim_up ? "up" : "down", percent);
	}

	return command_status_report(sh, err);
}

static int cmd_dim_up(const struct shell *sh, size_t argc, char **argv)
{
	return cmd_dim_common(sh, argc, argv, true);
}

static int cmd_dim_down(const struct shell *sh, size_t argc, char **argv)
{
	return cmd_dim_common(sh, argc, argv, false);
}

SHELL_STATIC_SUBCMD_SET_CREATE(
	dim_cmds,
	SHELL_CMD_ARG(up, NULL, "[percent|percent%]", cmd_dim_up, 1, 1),
	SHELL_CMD_ARG(down, NULL, "[percent|percent%]", cmd_dim_down, 1, 1),
	SHELL_SUBCMD_SET_END);

SHELL_CMD_REGISTER(on, NULL, "Turn the bound light on.", cmd_on);
SHELL_CMD_REGISTER(off, NULL, "Turn the bound light off.", cmd_off);
SHELL_CMD_REGISTER(dim, &dim_cmds, "Dim the bound light up or down.", NULL);
```

## src/usb_cdc_line_state.c
```c
/*
 * Copyright (c) 2026
 *
 * SPDX-License-Identifier: LicenseRef-Nordic-5-Clause
 */

/*
 * USB CDC ACM line state handler for boards that route the Zephyr shell to a
 * CDC ACM UART (nRF52840 DK and nRF52840 Dongle). On boards using a physical
 * UART (e.g. nRF54L15 DK), the compile-time guard below makes this file a
 * no-op.
 *
 * When a host opens the serial port (asserts DTR), this module signals DCD and
 * DSR back to the host so that terminal tools recognise the port as ready.
 *
 * SYS_INIT priority (52) must be higher than
 * CONFIG_SHELL_BACKEND_SERIAL_INIT_PRIORITY (51 in board conf files) so the
 * shell backend is already initialised when this handler registers itself.
 */

#include <zephyr/device.h>
#include <zephyr/drivers/uart.h>
#include <zephyr/init.h>
#include <zephyr/logging/log.h>
#include <zephyr/usb/usbd.h>
#include <zephyr/usb/usbd_msg.h>

LOG_MODULE_REGISTER(usb_cdc_line_state, LOG_LEVEL_INF);

#if defined(CONFIG_USB_DEVICE_STACK_NEXT) && \
	DT_NODE_HAS_COMPAT(DT_CHOSEN(zephyr_shell_uart), zephyr_cdc_acm_uart)

static const struct device *const shell_uart = DEVICE_DT_GET(DT_CHOSEN(zephyr_shell_uart));
static const struct device *const usb_dev = DEVICE_DT_GET(DT_NODELABEL(zephyr_udc0));

static void usb_cdc_msg_cb(struct usbd_context *const ctx, const struct usbd_msg *const msg)
{
	uint32_t dtr = 0U;

	ARG_UNUSED(ctx);

	if (msg->type != USBD_MSG_CDC_ACM_CONTROL_LINE_STATE || msg->dev != shell_uart) {
		return;
	}

	if (uart_line_ctrl_get(shell_uart, UART_LINE_CTRL_DTR, &dtr) || !dtr) {
		return;
	}

	/* Match the reference CDC ACM samples and tell the host the port is ready. */
	(void)uart_line_ctrl_set(shell_uart, UART_LINE_CTRL_DCD, 1);
	(void)uart_line_ctrl_set(shell_uart, UART_LINE_CTRL_DSR, 1);
}

static int usb_cdc_line_state_init(void)
{
	int err;

	if (!device_is_ready(shell_uart) || !device_is_ready(usb_dev)) {
		return 0;
	}

	STRUCT_SECTION_FOREACH(usbd_context, ctx) {
		if (ctx->dev != usb_dev) {
			continue;
		}

		err = usbd_msg_register_cb(ctx, usb_cdc_msg_cb);
		if (err == -EALREADY) {
			return 0;
		}

		return err;
	}

	return 0;
}

SYS_INIT(usb_cdc_line_state_init, POST_KERNEL, 52);

#endif
```
