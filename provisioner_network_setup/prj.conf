## CMakeLists.txt
```
#
# Copyright (c) 2026 Nordic Semiconductor ASA
#
# SPDX-License-Identifier: LicenseRef-Nordic-5-Clause
#

cmake_minimum_required(VERSION 3.20.0)
set(QEMU_EXTRA_FLAGS -s)

find_package(Zephyr REQUIRED HINTS $ENV{ZEPHYR_BASE})
project(bluetooth_mesh_provisioner)

target_sources(app PRIVATE
  src/main.c
  src/prov_cache.c
  src/provisioner_handler.c
  src/prov_scan_names.c
  src/prov_shell.c
  src/mesh_net_cfg.c
  src/mesh_recipes.c
  src/scenario_network1.c
)
target_include_directories(app PRIVATE include)

if (CONFIG_BUILD_WITH_TFM)
  target_include_directories(app PRIVATE
    $<TARGET_PROPERTY:tfm,TFM_BINARY_DIR>/api_ns/interface/include
  )
endif()
```

## Kconfig
```
#
# Copyright (c) 2026 Nordic Semiconductor ASA
#
# SPDX-License-Identifier: LicenseRef-Nordic-5-Clause
#

source "Kconfig.zephyr"

mainmenu "Bluetooth: Mesh Provisioner"

config MESH_PROVISIONER_SCAN_UUID_CACHE_MAX
	int "Max unified provisioner cache entries"
	default 50
	range 1 128
	help
	  Maximum entries kept for UUID, address, GAP name, scan visibility, and
	  auto-provision bookkeeping.

config MESH_PROVISIONER_AUTO_RETRY_MS
	int "Auto-provision retry interval in milliseconds"
	default 500
	range 0 60000
	help
	  Minimum spacing between repeated auto-provision attempts for the same UUID.

config MESH_PROVISIONER_THREAD_STACK_SIZE
	int "Provisioner thread stack size"
	default 4096
	help
	  Stack size for the provisioner thread that drives bt_mesh_provision_adv()
	  and node configuration.
```

## prj.conf
```kconfig
#
# Copyright (c) 2026 Nordic Semiconductor ASA
#
# SPDX-License-Identifier: LicenseRef-Nordic-5-Clause
#

# main() only calls bt_enable() and returns; 2048 is sufficient.
CONFIG_MAIN_STACK_SIZE=2048
CONFIG_SYSTEM_WORKQUEUE_STACK_SIZE=4800
CONFIG_BT_MESH_SETTINGS_WORKQ_STACK_SIZE=1700
CONFIG_BT_MESH_ADV_STACK_SIZE=4000
CONFIG_BT_RX_STACK_SIZE=3300

CONFIG_SHELL=y
CONFIG_SHELL_BACKEND_SERIAL=y
CONFIG_SHELL_STACK_SIZE=4096
CONFIG_SHELL_CMD_BUFF_SIZE=140

CONFIG_BT=y
CONFIG_LOG=y
CONFIG_LOG_MODE_MINIMAL=y
CONFIG_BT_OBSERVER=y
CONFIG_BT_BROADCASTER=y
CONFIG_BT_EXT_ADV=y

CONFIG_BT_CTLR_DUP_FILTER_LEN=0
CONFIG_BT_CTLR_LE_ENC=n
CONFIG_BT_CTLR_LE_PING=n
CONFIG_BT_DATA_LEN_UPDATE=n
CONFIG_BT_PHY_UPDATE=n
CONFIG_BT_CTLR_MIN_USED_CHAN=n
CONFIG_BT_CTLR_PRIVACY=n
CONFIG_BT_CTLR_CHAN_SEL_2=n

CONFIG_BT_MESH=y
CONFIG_BT_MESH_SUBNET_COUNT=5
CONFIG_BT_MESH_APP_KEY_COUNT=5
CONFIG_BT_MESH_ADV_BUF_COUNT=10
CONFIG_BT_MESH_TX_SEG_MSG_COUNT=3
CONFIG_BT_MESH_TX_SEG_MAX=32
CONFIG_BT_MESH_RX_SEG_MAX=32
CONFIG_BT_MESH_MODEL_GROUP_COUNT=10
CONFIG_BT_MESH_LABEL_COUNT=0
CONFIG_BT_MESH_CFG_CLI=y
CONFIG_BT_MESH_HEALTH_CLI=y
CONFIG_BT_MESH_BEACON_ENABLED=n
CONFIG_BT_MESH_RELAY=y
CONFIG_BT_MESH_CRPL=200

CONFIG_BT_MESH_PROVISIONER=y
CONFIG_BT_MESH_PROVISIONEE=n
CONFIG_BT_MESH_CDB=y
CONFIG_BT_MESH_CDB_NODE_COUNT=200
CONFIG_BT_MESH_CDB_SUBNET_COUNT=5
CONFIG_BT_MESH_CDB_APP_KEY_COUNT=5

CONFIG_BT_SETTINGS=y
CONFIG_FLASH=y
CONFIG_FLASH_MAP=y
# NVS + SETTINGS is used on e.g. nRF52; nRF54L uses ZMS via boards/nrf54l15dk_*_cpuapp.conf
# so TRUSTED_STORAGE (pulled in by BT_MESH_SECURE_STORAGE) gets a valid storage backend.
CONFIG_NVS=y
CONFIG_SETTINGS=y
CONFIG_BT_MESH_RPL_STORE_TIMEOUT=600
CONFIG_PM_PARTITION_SIZE_SETTINGS_STORAGE=0x8000

#CONFIG_BT_MESH_LOG_LEVEL_DBG=y
#CONFIG_BT_MESH_SETTINGS_LOG_LEVEL_DBG=y
#CONFIG_BT_MESH_NET_LOG_LEVEL_DBG=y
#CONFIG_BT_MESH_MODEL_LOG_LEVEL_DBG=y
#CONFIG_BT_MESH_TRANS_LOG_LEVEL_DBG=y
#CONFIG_BT_MESH_ACCESS_LOG_LEVEL_DBG=y
#CONFIG_BT_MESH_ADV_LOG_LEVEL_DBG=y
```

## boards/nrf52840dk_nrf52840.conf
```kconfig
#
# Copyright (c) 2026 Nordic Semiconductor ASA
#
# SPDX-License-Identifier: LicenseRef-Nordic-5-Clause
#

# Nordic SoftDevice Controller (Zephyr LL SW Split is unsupported for NCS mesh + SDC).
CONFIG_BT_LL_SOFTDEVICE=y
CONFIG_BT_LL_SW_SPLIT=n
```

## boards/nrf5340dk_nrf5340_cpuapp_ns.conf
```kconfig
#
# Copyright (c) 2026 Nordic Semiconductor ASA
#
# SPDX-License-Identifier: LicenseRef-Nordic-5-Clause
#

CONFIG_SECURE_STORAGE=n

# Nordic SoftDevice Controller (Zephyr LL SW Split is unsupported for NCS mesh + SDC).
CONFIG_BT_LL_SOFTDEVICE=y
CONFIG_BT_LL_SW_SPLIT=n
```

## boards/nrf54l15dk_nrf54l15_cpuapp.conf
```kconfig
#
# Copyright (c) 2026 Nordic Semiconductor ASA
#
# SPDX-License-Identifier: LicenseRef-Nordic-5-Clause
#

#
# nRF54L15: Trusted storage for mesh requires SETTINGS_ZMS (NVS is not a valid
# backend for TRUSTED_STORAGE on SOC_SERIES_NRF54LX). See nrf/subsys/trusted_storage/Kconfig.
#

# Nordic SoftDevice Controller (Zephyr LL SW Split is unsupported for NCS mesh + SDC).
CONFIG_BT_LL_SOFTDEVICE=y
CONFIG_BT_LL_SW_SPLIT=n

CONFIG_SOC_FLASH_NRF_PARTIAL_ERASE=n
CONFIG_NVS=n
CONFIG_NVS_LOOKUP_CACHE=n
CONFIG_SETTINGS_NVS_NAME_CACHE=n
CONFIG_ZMS=y
CONFIG_SETTINGS_ZMS_CUSTOM_SECTOR_COUNT=y
CONFIG_SETTINGS_ZMS_SECTOR_COUNT=8
CONFIG_ZMS_LOOKUP_CACHE=y
CONFIG_ZMS_LOOKUP_CACHE_SIZE=512
CONFIG_ZMS_LOOKUP_CACHE_FOR_SETTINGS=y

# Align stack sizes with other Nordic mesh samples on this SoC
CONFIG_SYSTEM_WORKQUEUE_STACK_SIZE=4800
CONFIG_BT_RX_STACK_SIZE=5120
CONFIG_BT_MESH_SETTINGS_WORKQ_STACK_SIZE=1800
```

## boards/qemu_x86.conf
```kconfig
#
# Copyright (c) 2026 Nordic Semiconductor ASA
#
# SPDX-License-Identifier: LicenseRef-Nordic-5-Clause
#

# nrf_security only supports Cortex-M via PSA crypto libraries.
# Enforcing usage of built-in Mbed TLS for native simulator.
CONFIG_NRF_SECURITY=n
CONFIG_MBEDTLS_ENABLE_HEAP=n
CONFIG_TRUSTED_STORAGE=n
CONFIG_SECURE_STORAGE=y
```

## src/main.c
```c
/*
 * Copyright (c) 2019 Tobias Svehagen
 * Copyright (c) 2026 Nordic Semiconductor ASA
 *
 * SPDX-License-Identifier: Apache-2.0
 */
#include <zephyr/bluetooth/bluetooth.h>
#include <zephyr/sys/printk.h>

#include "provisioner_handler.h"

static void bt_ready(int err)
{
	if (err) {
		printk("Bluetooth init failed (err %d)\n", err);
		return;
	}

	printk("Bluetooth initialized\n");

	err = provisioner_handler_bluetooth_ready();
	if (err) {
		printk("Provisioner setup failed (err %d)\n", err);
	}
}

int main(void)
{
	int err;

	printk("Initializing...\n");

	err = bt_enable(bt_ready);
	if (err) {
		printk("Bluetooth init failed (err %d)\n", err);
	}

	return 0;
}
```

## include/mesh_config_types.h
```c
/*
 * Copyright (c) 2026 Nordic Semiconductor ASA
 *
 * SPDX-License-Identifier: LicenseRef-Nordic-5-Clause
 */

#ifndef MESH_CONFIG_TYPES_H_
#define MESH_CONFIG_TYPES_H_

#include <stdbool.h>
#include <stddef.h>
#include <stdint.h>

#include <zephyr/sys/util.h>

/*
 * Maximum elements per node this configurator supports (stack buffers, loops).
 * Override from the application or via -DMESH_CONFIG_MAX_ELEM_PER_NODE=N.
 */
#ifndef MESH_CONFIG_MAX_ELEM_PER_NODE
#define MESH_CONFIG_MAX_ELEM_PER_NODE 5
#endif

/* ------------------------------------------------------------------ */
/* Enums                                                              */
/* ------------------------------------------------------------------ */

enum mesh_setup_op {
	MESH_OP_NETKEY_ADD, /* bt_mesh_cfg_cli_net_key_add           */
	MESH_OP_APPKEY_ADD, /* bt_mesh_cfg_cli_app_key_add           */
	MESH_OP_BIND_APP,   /* bt_mesh_cfg_cli_mod_app_bind[_vnd]    */
	MESH_OP_SUB_ADD,    /* bt_mesh_cfg_cli_mod_sub_add[_vnd]     */
	MESH_OP_PUB_SET,    /* bt_mesh_cfg_cli_mod_pub_set[_vnd]     */
};

/*
 * MESH_ELEM_ADDR_OFF: target = node->addr + elem_param.
 *   elem_param = 0  primary element.
 *   elem_param = N  Nth element (consecutive unicast).
 *
 * MESH_ELEM_ALL_WITH_MOD: expand to every element whose composition
 *   contains 'model'.  Requires composition data fetched beforehand.
 */
enum mesh_elem_sel {
	MESH_ELEM_ADDR_OFF,
	MESH_ELEM_ALL_WITH_MOD,
};

/* ------------------------------------------------------------------ */
/* Model reference                                                    */
/* ------------------------------------------------------------------ */

/* Sentinel matching the shell's CID_NVAL - marks a SIG model. */
#define MESH_CID_NVAL 0xffff

struct mesh_model_ref {
	uint16_t id;
	uint16_t cid; /* MESH_CID_NVAL for SIG models */
};

#define SIG_MODEL(_id) ((struct mesh_model_ref){ .id = (_id), .cid = MESH_CID_NVAL })

#define VND_MODEL(_id, _cid) ((struct mesh_model_ref){ .id = (_id), .cid = (_cid) })

/* ------------------------------------------------------------------ */
/* Setup step                                                          */
/* ------------------------------------------------------------------ */

struct mesh_setup_step {
	enum mesh_setup_op op;
	enum mesh_elem_sel elem_sel;
	uint16_t elem_param; /* offset (ADDR_OFF only)    */
	struct mesh_model_ref model; /* unused for key ops        */
	uint16_t app_idx; /* BIND and PUB only         */
	union {
		struct {
			uint16_t net_key_idx;
		} netkey;

		struct {
			uint16_t net_key_idx;
			uint16_t app_key_idx;
		} appkey;

		struct {
			uint16_t sub_addr;
		} sub;

		struct {
			uint16_t pub_addr;
			bool cred_flag;
			uint8_t ttl;
			uint8_t period;
			uint8_t transmit;
		} pub;
	} u;
};

/* ------------------------------------------------------------------ */
/* Step construction macros                                            */
/* ------------------------------------------------------------------ */

#define NETKEY_ADD(_net_key_idx)					\
	{								\
		.op = MESH_OP_NETKEY_ADD,				\
		.elem_sel = MESH_ELEM_ADDR_OFF,			\
		.elem_param = 0,					\
		.u.netkey = { .net_key_idx = (_net_key_idx) },		\
	}

#define APPKEY_ADD(_net_key_idx, _app_key_idx)				\
	{								\
		.op = MESH_OP_APPKEY_ADD,				\
		.elem_sel = MESH_ELEM_ADDR_OFF,			\
		.elem_param = 0,					\
		.u.appkey = {						\
			.net_key_idx = (_net_key_idx),			\
			.app_key_idx = (_app_key_idx),			\
		},							\
	}

#define BIND(_elem_off, _model, _app_idx)				\
	{								\
		.op = MESH_OP_BIND_APP,				\
		.elem_sel = MESH_ELEM_ADDR_OFF,			\
		.elem_param = (_elem_off),				\
		.model = (_model),					\
		.app_idx = (_app_idx),				\
	}

#define BIND_ALL(_model, _app_idx)					\
	{								\
		.op = MESH_OP_BIND_APP,				\
		.elem_sel = MESH_ELEM_ALL_WITH_MOD,			\
		.elem_param = 0,					\
		.model = (_model),					\
		.app_idx = (_app_idx),				\
	}

#define SUB(_elem_off, _model, _sub_addr)				\
	{								\
		.op = MESH_OP_SUB_ADD,				\
		.elem_sel = MESH_ELEM_ADDR_OFF,			\
		.elem_param = (_elem_off),				\
		.model = (_model),					\
		.u.sub = { .sub_addr = (_sub_addr) },			\
	}

#define SUB_ALL(_model, _sub_addr)					\
	{								\
		.op = MESH_OP_SUB_ADD,				\
		.elem_sel = MESH_ELEM_ALL_WITH_MOD,			\
		.elem_param = 0,					\
		.model = (_model),					\
		.u.sub = { .sub_addr = (_sub_addr) },			\
	}

#define PUB(_elem_off, _model, _app_idx, _addr, _ttl, _period, _xmit)	\
	{								\
		.op = MESH_OP_PUB_SET,				\
		.elem_sel = MESH_ELEM_ADDR_OFF,			\
		.elem_param = (_elem_off),				\
		.model = (_model),					\
		.app_idx = (_app_idx),				\
		.u.pub = {						\
			.pub_addr = (_addr),				\
			.cred_flag = false,				\
			.ttl = (_ttl),					\
			.period = (_period),				\
			.transmit = (_xmit),				\
		},							\
	}

#define PUB_ALL(_model, _app_idx, _addr, _ttl, _period, _xmit)		\
	{								\
		.op = MESH_OP_PUB_SET,				\
		.elem_sel = MESH_ELEM_ALL_WITH_MOD,			\
		.elem_param = 0,					\
		.model = (_model),					\
		.app_idx = (_app_idx),				\
		.u.pub = {						\
			.pub_addr = (_addr),				\
			.cred_flag = false,				\
			.ttl = (_ttl),					\
			.period = (_period),				\
			.transmit = (_xmit),				\
		},							\
	}

/* ------------------------------------------------------------------ */
/* Recipe descriptor                                                   */
/* ------------------------------------------------------------------ */

struct mesh_recipe {
	const struct mesh_setup_step *steps;
	size_t step_cnt;
};

#define RECIPE_ENTRY(_steps_arr) \
	{ .steps = (_steps_arr), .step_cnt = ARRAY_SIZE(_steps_arr) }

/* ------------------------------------------------------------------ */
/* Scenario row                                                        */
/* ------------------------------------------------------------------ */

enum scenario_match_type {
	SCENARIO_MATCH_UUID,
	SCENARIO_MATCH_NAME,
};

/*
 * Rotating rows (NODE_NAME_ROTATE): recipe_ids points to a static array of recipe IDs and
 * recipe_cnt holds its length. recipe_idx advances circularly only after that recipe was
 * successfully applied to a node (executor consumes the current slot).
 * recipe_ids == NULL means the single recipe_id field is used (standard behaviour).
 * The scenario array must NOT be declared const when any rotating row is present, since
 * recipe_idx is mutated at runtime.
 */
struct scenario_row {
	const char    *match;
	uint8_t        match_type;
	uint8_t        recipe_id;   /* single-recipe path; used when recipe_ids == NULL */
	const uint8_t *recipe_ids;  /* rotating recipe list; NULL for non-rotating rows */
	uint8_t        recipe_cnt;  /* length of recipe_ids[]                           */
	uint8_t        recipe_idx;  /* mutable: current rotation position               */
};

#define NODE_CFG_UUID(_uuid_hex, _recipe_id)					\
	{									\
		.match      = (_uuid_hex),					\
		.match_type = SCENARIO_MATCH_UUID,				\
		.recipe_id  = (uint8_t)(_recipe_id),				\
	}

#define NODE_CFG_NAME(_name, _recipe_id)					\
	{									\
		.match      = (_name),						\
		.match_type = SCENARIO_MATCH_NAME,				\
		.recipe_id  = (uint8_t)(_recipe_id),				\
	}

/*
 * NODE_NAME_ROTATE: match by exact device name and assign recipes in a circular sequence.
 * Each time a device with this name finishes successful scenario configuration, the next
 * recipe in the list becomes current for the following device.
 * Usage: NODE_NAME_ROTATE("Name", RECIPE_A, RECIPE_B, ...)
 * The recipe_ids compound literal has static storage duration when used at file scope.
 */
#define NODE_NAME_ROTATE(_name, ...)						\
	{									\
		.match      = (_name),						\
		.match_type = SCENARIO_MATCH_NAME,				\
		.recipe_ids = (const uint8_t[]){ __VA_ARGS__ },			\
		.recipe_cnt = sizeof((uint8_t[]){ __VA_ARGS__ }),		\
	}

#define NODE_FULL(_uuid_hex, _recipe_id) NODE_CFG_UUID((_uuid_hex), (_recipe_id))

#define NODE_PREFIX(_uuid_hex, _recipe_id) NODE_CFG_UUID((_uuid_hex), (_recipe_id))

#define NODE_NAME(_name, _recipe_id) NODE_CFG_NAME((_name), (_recipe_id))

#endif /* MESH_CONFIG_TYPES_H_ */
```

## include/mesh_net_cfg.h
```c
/*
 * Copyright (c) 2026 Nordic Semiconductor ASA
 *
 * SPDX-License-Identifier: LicenseRef-Nordic-5-Clause
 */

#ifndef MESH_NET_CFG_H_
#define MESH_NET_CFG_H_

#include <stddef.h>
#include <stdint.h>

#include <zephyr/bluetooth/mesh/cdb.h>

struct scenario_row;

int mesh_config_apply(struct bt_mesh_cdb_node *node, struct scenario_row *rows,
		      size_t n_rows, const char *name);

int mesh_config_apply_recipe(struct bt_mesh_cdb_node *node, uint8_t recipe_id);

const char *mesh_recipe_name(uint8_t recipe_id);

uint8_t mesh_scenario_lookup_recipe_id(const uint8_t uuid[16], const char *name,
				       struct scenario_row *rows, size_t n_rows);

/**
 * Advance rotating recipe state after the given recipe_id was successfully
 * applied to a node (no-op for non-rotating rows; no-op if peek no longer
 * matches recipe_id).
 */
void mesh_scenario_consume_recipe_id(const uint8_t uuid[16], const char *name,
				     struct scenario_row *rows, size_t n_rows,
				     uint8_t recipe_id);

#endif /* MESH_NET_CFG_H_ */
```

## include/mesh_recipes.h
```c
/*
 * Copyright (c) 2026 Nordic Semiconductor ASA
 *
 * SPDX-License-Identifier: LicenseRef-Nordic-5-Clause
 */

#ifndef MESH_RECIPES_H_
#define MESH_RECIPES_H_

#include <zephyr/bluetooth/mesh.h>

#include "mesh_config_types.h"

/* ------------------------------------------------------------------ */
/* Network constants - adjust per deployment                           */
/* ------------------------------------------------------------------ */

#define NET_PRIMARY 0x000U /* primary network key index         */
#define APPKEY_IDX 0x000U /* app key index for all lighting    */

/* Group addresses. */
#define GRP_1 0xC001U
#define GRP_2 0xC002U

#define PUB_TTL 5
#define PUB_PERIOD_OFF 0 /* event-driven, no periodic pub */
#define PUB_XMIT_1x100 BT_MESH_PUB_TRANSMIT(1, 100) /* 1 retx, 100 ms */

/* ------------------------------------------------------------------ */
/* Recipe IDs                                                          */
/* ------------------------------------------------------------------ */

enum mesh_recipe_id {
	RECIPE_NONE = 0x00, /* reserved / unprovisioned  */
	RECIPE_LIGHT_CTRL_1 = 0x01,
	RECIPE_LIGHT_CTRL_2 = 0x02,
	RECIPE_DIMMER_1 = 0x03,
	RECIPE_DIMMER_2 = 0x04,
	RECIPE_LIGHT_SW_1 = 0x05,
	RECIPE_LIGHT_SW_2 = 0x06,
	RECIPE_ENOCEAN_BCAST = 0x07,
	RECIPE_COUNT,
};

extern const struct mesh_recipe mesh_recipes[RECIPE_COUNT];

#endif /* MESH_RECIPES_H_ */
```

## include/prov_cache.h
```c
/*
 * Copyright (c) 2026 Nordic Semiconductor ASA
 *
 * SPDX-License-Identifier: LicenseRef-Nordic-5-Clause
 */

#ifndef PROV_CACHE_H__
#define PROV_CACHE_H__

#include <stdbool.h>
#include <stddef.h>
#include <stdint.h>

#include <zephyr/bluetooth/addr.h>

/* Enough for typical GAP names in PB-GATT scan response without BT_DEVICE_NAME_MAX. */
#define PROV_CACHE_NAME_BUF_SIZE 33

int prov_cache_adv_uuid_seen(const bt_addr_le_t *addr, const uint8_t uuid[16]);
bool prov_cache_scan_rsp_name_seen(const bt_addr_le_t *addr, const uint8_t *name, size_t len,
				   uint8_t uuid_out[16]);
int prov_cache_ensure_uuid(const uint8_t uuid[16]);
bool prov_cache_lookup_name(const uint8_t uuid[16], char *name, size_t name_len);
bool prov_cache_maybe_mark_visible(const uint8_t uuid[16], size_t *visible_idx);
void prov_cache_mark_all_ready_visible(void);
size_t prov_cache_visible_count(void);
int prov_cache_visible_uuid_by_index(size_t idx, uint8_t uuid[16]);
bool prov_cache_should_auto_attempt(const uint8_t uuid[16], int64_t now_ms, int32_t retry_ms);
bool prov_cache_find_next_auto_candidate(size_t *cursor, int64_t now_ms, int32_t retry_ms,
					 uint8_t uuid[16]);
void prov_cache_mark_attempt(const uint8_t uuid[16], int64_t now_ms);
void prov_cache_on_configuration_success(const uint8_t uuid[16]);

#endif /* PROV_CACHE_H__ */
```

## include/prov_scan_names.h
```c
/*
 * Copyright (c) 2026 Nordic Semiconductor ASA
 *
 * SPDX-License-Identifier: LicenseRef-Nordic-5-Clause
 */

#ifndef PROV_SCAN_NAMES_H__
#define PROV_SCAN_NAMES_H__

#include <stdbool.h>

/** Register LE scan listener; call before mesh starts scanning. */
void prov_scan_names_init(void);

/**
 * Switch mesh LE scan to active so SCAN_RSP (GAP name on PB-GATT devices) is received.
 * Uses Zephyr mesh stack routine (same scan as mesh, not a second controller scan).
 */
int prov_scan_names_set_mesh_active_scan(bool active);

#endif /* PROV_SCAN_NAMES_H__ */
```

## include/prov_shell.h
```c
/*
 * Copyright (c) 2026 Nordic Semiconductor ASA
 *
 * SPDX-License-Identifier: LicenseRef-Nordic-5-Clause
 */

#ifndef PROV_SHELL_H__
#define PROV_SHELL_H__

#include <stddef.h>
#include <stdint.h>

/** Called from mesh unprovisioned beacon callback; updates fallback UUID state and auto policy. */
void prov_shell_feed_beacon(const uint8_t uuid[16]);

/** Re-evaluate whether this UUID became visible in the scan list. */
void prov_shell_note_uuid_update(const uint8_t uuid[16]);

/** Schedule a one-shot auto retry pass. */
void prov_shell_auto_retry_submit(void);

/** Snapshot count of visible UUIDs (for provision-by-index). */
size_t prov_shell_scan_count(void);

/** Copy visible UUID at index; returns 0 or -EINVAL / -ENOENT. */
int prov_shell_get_cached_uuid(size_t idx, uint8_t uuid[16]);

/** Returns true if auto-provisioning mode is enabled. */
bool prov_shell_auto_provision_enabled(void);

#endif /* PROV_SHELL_H__ */
```

## include/provisioner_handler.h
```c
/*
 * Copyright (c) 2026 Nordic Semiconductor ASA
 *
 * SPDX-License-Identifier: LicenseRef-Nordic-5-Clause
 */

/** @file
 *  @brief Bluetooth Mesh provisioner (CDB) logic
 */

#ifndef PROVISIONER_HANDLER_H__
#define PROVISIONER_HANDLER_H__

#include <stdint.h>
#include <zephyr/bluetooth/mesh.h>

#ifdef __cplusplus
extern "C" {
#endif

const struct bt_mesh_prov *provisioner_handler_prov(void);
const struct bt_mesh_comp *provisioner_handler_init(void);
int provisioner_handler_bluetooth_ready(void);

/** Queue provisioning for the given device UUID (PB-ADV). Returns 0, -EBUSY, or -ENODEV. */
int provisioner_handler_request_provision(const uint8_t uuid[16]);

/**
 * Queue provisioning for the given device UUID and carry the selected recipe into
 * post-provision configuration. Use RECIPE_NONE when no preselection exists.
 */
int provisioner_handler_request_provision_recipe(const uint8_t uuid[16], uint8_t recipe_id);

#ifdef __cplusplus
}
#endif

#endif /* PROVISIONER_HANDLER_H__ */
```

## include/scenario_network1.h
```c
/*
 * Copyright (c) 2026 Nordic Semiconductor ASA
 *
 * SPDX-License-Identifier: LicenseRef-Nordic-5-Clause
 */

#ifndef SCENARIO_NETWORK1_H_
#define SCENARIO_NETWORK1_H_

#include <stddef.h>

#include "mesh_recipes.h"

extern struct scenario_row scenario_b1_corridor[];
extern const size_t scenario_b1_corridor_len;

#endif /* SCENARIO_NETWORK1_H_ */
```

## src/mesh_net_cfg.c
```c
/*
 * Copyright (c) 2026 Nordic Semiconductor ASA
 *
 * SPDX-License-Identifier: LicenseRef-Nordic-5-Clause
 */

#include "mesh_net_cfg.h"

#include <errno.h>
#include <string.h>

#include <zephyr/bluetooth/mesh.h>
#include <zephyr/bluetooth/mesh/cdb.h>
#include <zephyr/bluetooth/mesh/cfg_cli.h>
#include <zephyr/kernel.h>
#include <zephyr/logging/log.h>
#include <zephyr/net_buf.h>
#include <zephyr/sys/util.h>

#include "mesh_recipes.h"

LOG_MODULE_REGISTER(mesh_net_cfg, LOG_LEVEL_DBG);

#define MESH_CFG_STATUS_SUCCESS 0x00U
#define MESH_CFG_STATUS_IDX_ALREADY_STORED 0x06U

static uint8_t s_comp_page[BT_MESH_RX_SDU_MAX];
static size_t s_comp_page_len;
static K_MUTEX_DEFINE(scenario_mutex);

static inline bool mesh_cfg_key_add_ok(uint8_t status)
{
	return status == MESH_CFG_STATUS_SUCCESS || status == MESH_CFG_STATUS_IDX_ALREADY_STORED;
}

static const uint8_t *provisioner_net_key_get(uint16_t net_key_idx)
{
	static uint8_t key[16];
	struct bt_mesh_cdb_subnet *sub = bt_mesh_cdb_subnet_get(net_key_idx);

	if (!sub) {
		return NULL;
	}
	if (bt_mesh_cdb_subnet_key_export(sub, 0, key) != 0) {
		return NULL;
	}
	return key;
}

static const uint8_t *provisioner_app_key_get(uint16_t app_key_idx)
{
	static uint8_t key[16];
	struct bt_mesh_cdb_app_key *ak = bt_mesh_cdb_app_key_get(app_key_idx);

	if (!ak) {
		return NULL;
	}
	if (bt_mesh_cdb_app_key_export(ak, 0, key) != 0) {
		return NULL;
	}
	return key;
}

static bool uuid_hex_match(const char *uuid_hex, const uint8_t *dev_uuid)
{
	uint8_t pattern[16];
	size_t hex_len = strlen(uuid_hex);
	size_t match_len = hex_len / 2U;
	size_t decoded;

	if (match_len == 0 || match_len > 16 || (hex_len & 1U)) {
		return false;
	}

	decoded = hex2bin(uuid_hex, hex_len, pattern, match_len);
	if (decoded != match_len) {
		return false;
	}

	return memcmp(pattern, dev_uuid, match_len) == 0;
}

static bool device_name_match(const char *pattern, const char *name)
{
	if (pattern == NULL || pattern[0] == '\0' || name == NULL || name[0] == '\0') {
		return false;
	}

	return strcmp(pattern, name) == 0;
}

static struct scenario_row *scenario_find_row(const uint8_t *dev_uuid,
					      const char *name,
					      struct scenario_row *rows,
					      size_t n_rows)
{
	struct scenario_row *best = NULL;
	size_t best_uuid_len = 0;

	for (size_t i = 0; i < n_rows; i++) {
		if (rows[i].match_type != SCENARIO_MATCH_UUID) {
			continue;
		}

		size_t match_len = strlen(rows[i].match) / 2U;

		if (match_len > best_uuid_len && uuid_hex_match(rows[i].match, dev_uuid)) {
			best = &rows[i];
			best_uuid_len = match_len;
		}
	}

	if (best != NULL) {
		return best;
	}

	for (size_t i = 0; i < n_rows; i++) {
		if (rows[i].match_type != SCENARIO_MATCH_NAME) {
			continue;
		}

		if (device_name_match(rows[i].match, name)) {
			return &rows[i];
		}
	}

	return NULL;
}

/* Returns the current recipe ID without advancing the rotating index. */
static uint8_t scenario_row_peek_recipe_id(const struct scenario_row *row)
{
	if (row->recipe_ids != NULL) {
		return row->recipe_ids[row->recipe_idx];
	}

	return row->recipe_id;
}

/*
 * Consume the current recipe ID for a rotating row after that recipe was
 * successfully applied to the node (bind/sub/pub steps completed).
 */
static void scenario_row_consume_recipe_id(struct scenario_row *row, uint8_t recipe_id)
{
	if (row->recipe_ids == NULL) {
		return;
	}

	if (scenario_row_peek_recipe_id(row) != recipe_id) {
		return;
	}

	row->recipe_idx = (row->recipe_idx + 1) % row->recipe_cnt;
}

static bool comp_elem_has_model(uint16_t primary, uint16_t elem_addr,
				const struct mesh_model_ref *model)
{
	struct net_buf_simple page_buf;
	struct bt_mesh_comp_p0 comp;
	struct bt_mesh_comp_p0_elem elem;
	size_t idx;
	int err;

	if (elem_addr < primary) {
		return false;
	}

	idx = (size_t)(elem_addr - primary);
	if (idx >= MESH_CONFIG_MAX_ELEM_PER_NODE) {
		return false;
	}

	net_buf_simple_init_with_data(&page_buf, s_comp_page, s_comp_page_len);
	err = bt_mesh_comp_p0_get(&comp, &page_buf);
	if (err) {
		return false;
	}

	for (size_t i = 0; i < idx; i++) {
		if (!bt_mesh_comp_p0_elem_pull(&comp, &elem)) {
			return false;
		}
	}

	if (!bt_mesh_comp_p0_elem_pull(&comp, &elem)) {
		return false;
	}

	if (model->cid == MESH_CID_NVAL) {
		for (int s = 0; s < elem.nsig; s++) {
			if (bt_mesh_comp_p0_elem_mod(&elem, s) == model->id) {
				return true;
			}
		}
	} else {
		for (int v = 0; v < elem.nvnd; v++) {
			struct bt_mesh_mod_id_vnd vid = bt_mesh_comp_p0_elem_mod_vnd(&elem, v);

			if (vid.id == model->id && vid.company == model->cid) {
				return true;
			}
		}
	}

	return false;
}

static int comp_data_fetch(struct bt_mesh_cdb_node *node, uint16_t *elem_addrs,
			   size_t elem_addrs_cap, size_t *n_elems_out)
{
	NET_BUF_SIMPLE_DEFINE(buf, BT_MESH_RX_SDU_MAX);
	struct net_buf_simple page_buf;
	uint8_t page_rsp;
	struct bt_mesh_comp_p0 comp;
	struct bt_mesh_comp_p0_elem elem;
	size_t n_elem;
	int err;

	*n_elems_out = 0;

	err = bt_mesh_cfg_cli_comp_data_get(node->net_idx, node->addr, 0, &page_rsp, &buf);
	if (err) {
		LOG_ERR("comp data get failed (err %d)", err);
		return err;
	}

	if (page_rsp != 0U) {
		LOG_ERR("unexpected composition page %u", page_rsp);
		return -EIO;
	}

	if (buf.len > sizeof(s_comp_page)) {
		LOG_ERR("composition page too large");
		return -ENOMEM;
	}

	memcpy(s_comp_page, buf.data, buf.len);
	s_comp_page_len = buf.len;

	net_buf_simple_init_with_data(&page_buf, s_comp_page, s_comp_page_len);
	err = bt_mesh_comp_p0_get(&comp, &page_buf);
	if (err) {
		LOG_ERR("comp parse failed (err %d)", err);
		return err;
	}

	n_elem = 0;
	while (bt_mesh_comp_p0_elem_pull(&comp, &elem)) {
		if (n_elem >= elem_addrs_cap) {
			LOG_ERR("composition element count exceeds configured maximum");
			return -ENOMEM;
		}
		elem_addrs[n_elem] = (uint16_t)(node->addr + n_elem);
		n_elem++;
	}

	*n_elems_out = n_elem;
	return 0;
}

static int apply_step(struct bt_mesh_cdb_node *node, const struct mesh_setup_step *step,
		      const uint16_t *elem_addrs, size_t n_elems)
{
	uint16_t primary = node->addr;
	uint16_t net_idx = node->net_idx;
	uint8_t status = MESH_CFG_STATUS_SUCCESS;
	int err = 0;

	uint16_t addrs[MESH_CONFIG_MAX_ELEM_PER_NODE];
	size_t addr_cnt = 0;

	switch (step->elem_sel) {
	case MESH_ELEM_ADDR_OFF:
		if (step->elem_param >= n_elems) {
			LOG_ERR("elem_param %u >= n_elems %zu", step->elem_param, n_elems);
			return -EINVAL;
		}
		addrs[0] = elem_addrs[step->elem_param];
		addr_cnt = 1;
		break;
	case MESH_ELEM_ALL_WITH_MOD:
		for (size_t i = 0; i < n_elems; i++) {
			if (!comp_elem_has_model(primary, elem_addrs[i], &step->model)) {
				continue;
			}
			if (addr_cnt >= MESH_CONFIG_MAX_ELEM_PER_NODE) {
				LOG_ERR("ALL_WITH_MOD: element overflow");
				return -ENOMEM;
			}
			addrs[addr_cnt++] = elem_addrs[i];
		}
		break;
	default:
		return -ENOTSUP;
	}

	for (size_t i = 0; i < addr_cnt && !err; i++) {
		uint16_t ea = addrs[i];
		bool sig = (step->model.cid == MESH_CID_NVAL);

		switch (step->op) {
		case MESH_OP_NETKEY_ADD: {
			const uint8_t *key = provisioner_net_key_get(step->u.netkey.net_key_idx);

			if (!key) {
				err = -ENOENT;
				break;
			}
			LOG_INF("bt_mesh_cfg_cli_net_key_add dst 0x%04x net_idx=%u net_key_idx=%u",
				primary, net_idx, step->u.netkey.net_key_idx);
			err = bt_mesh_cfg_cli_net_key_add(net_idx, primary,
							  step->u.netkey.net_key_idx, key, &status);
			if (!err && !mesh_cfg_key_add_ok(status)) {
				err = -EIO;
			}
			break;
		}
		case MESH_OP_APPKEY_ADD: {
			const uint8_t *key = provisioner_app_key_get(step->u.appkey.app_key_idx);

			if (!key) {
				err = -ENOENT;
				break;
			}
			LOG_INF("bt_mesh_cfg_cli_app_key_add dst 0x%04x net_idx=%u net_key_idx=%u "
				"app_key_idx=%u",
				primary, net_idx, step->u.appkey.net_key_idx,
				step->u.appkey.app_key_idx);
			err = bt_mesh_cfg_cli_app_key_add(net_idx, primary,
							  step->u.appkey.net_key_idx,
							  step->u.appkey.app_key_idx, key, &status);
			if (!err && !mesh_cfg_key_add_ok(status)) {
				err = -EIO;
			}
			break;
		}
		case MESH_OP_BIND_APP:
			if (sig) {
				LOG_INF("bt_mesh_cfg_cli_mod_app_bind dst 0x%04x net_idx=%u elem 0x%04x "
					"app_idx=%u model_id=0x%04x",
					primary, net_idx, ea, step->app_idx, step->model.id);
				err = bt_mesh_cfg_cli_mod_app_bind(net_idx, primary, ea, step->app_idx,
								   step->model.id, &status);
			} else {
				LOG_INF("bt_mesh_cfg_cli_mod_app_bind_vnd dst 0x%04x net_idx=%u "
					"elem 0x%04x app_idx=%u model_id=0x%04x company=0x%04x",
					primary, net_idx, ea, step->app_idx, step->model.id,
					step->model.cid);
				err = bt_mesh_cfg_cli_mod_app_bind_vnd(net_idx, primary, ea,
								       step->app_idx, step->model.id,
								       step->model.cid, &status);
			}
			if (!err && status != MESH_CFG_STATUS_SUCCESS) {
				err = -EIO;
			}
			break;
		case MESH_OP_SUB_ADD:
			if (sig) {
				LOG_INF("bt_mesh_cfg_cli_mod_sub_add dst 0x%04x net_idx=%u elem 0x%04x "
					"group 0x%04x model_id=0x%04x",
					primary, net_idx, ea, step->u.sub.sub_addr, step->model.id);
				err = bt_mesh_cfg_cli_mod_sub_add(net_idx, primary, ea,
								  step->u.sub.sub_addr,
								  step->model.id, &status);
			} else {
				LOG_INF("bt_mesh_cfg_cli_mod_sub_add_vnd dst 0x%04x net_idx=%u "
					"elem 0x%04x group 0x%04x model_id=0x%04x company=0x%04x",
					primary, net_idx, ea, step->u.sub.sub_addr, step->model.id,
					step->model.cid);
				err = bt_mesh_cfg_cli_mod_sub_add_vnd(net_idx, primary, ea,
								      step->u.sub.sub_addr,
								      step->model.id,
								      step->model.cid, &status);
			}
			if (!err && status != MESH_CFG_STATUS_SUCCESS) {
				err = -EIO;
			}
			break;
		case MESH_OP_PUB_SET: {
			struct bt_mesh_cfg_cli_mod_pub pub = {
				.addr = step->u.pub.pub_addr,
				.uuid = NULL,
				.app_idx = step->app_idx,
				.cred_flag = step->u.pub.cred_flag,
				.ttl = step->u.pub.ttl,
				.period = step->u.pub.period,
				.transmit = step->u.pub.transmit,
			};

			if (sig) {
				LOG_INF("bt_mesh_cfg_cli_mod_pub_set dst 0x%04x net_idx=%u elem 0x%04x "
					"model_id=0x%04x pub_addr=0x%04x app_idx=%u ttl=%u period=%u "
					"cred_flag=%u transmit=0x%02x",
					primary, net_idx, ea, step->model.id, pub.addr, pub.app_idx,
					pub.ttl, pub.period, (unsigned int)pub.cred_flag, pub.transmit);
				err = bt_mesh_cfg_cli_mod_pub_set(net_idx, primary, ea, step->model.id,
								  &pub, &status);
			} else {
				LOG_INF("bt_mesh_cfg_cli_mod_pub_set_vnd dst 0x%04x net_idx=%u "
					"elem 0x%04x model_id=0x%04x company=0x%04x pub_addr=0x%04x "
					"app_idx=%u ttl=%u period=%u cred_flag=%u transmit=0x%02x",
					primary, net_idx, ea, step->model.id, step->model.cid, pub.addr,
					pub.app_idx, pub.ttl, pub.period, (unsigned int)pub.cred_flag,
					pub.transmit);
				err = bt_mesh_cfg_cli_mod_pub_set_vnd(net_idx, primary, ea,
								      step->model.id,
								      step->model.cid, &pub,
								      &status);
			}
			if (!err && status != MESH_CFG_STATUS_SUCCESS) {
				err = -EIO;
			}
			break;
		}
		default:
			return -ENOTSUP;
		}
	}

	return err;
}

int mesh_config_apply_recipe(struct bt_mesh_cdb_node *node, uint8_t recipe_id)
{
	const struct mesh_recipe *recipe;
	uint16_t elem_addrs[MESH_CONFIG_MAX_ELEM_PER_NODE];
	size_t n_elems = 0;
	int err;

	if (recipe_id == RECIPE_NONE || recipe_id >= RECIPE_COUNT) {
		return -ENOENT;
	}

	recipe = &mesh_recipes[recipe_id];

	err = comp_data_fetch(node, elem_addrs, ARRAY_SIZE(elem_addrs), &n_elems);
	if (err) {
		return err;
	}

	if (n_elems != node->num_elem) {
		LOG_ERR("composition n_elems %zu != CDB num_elem %u", n_elems, node->num_elem);
		return -EINVAL;
	}

	for (size_t s = 0; s < recipe->step_cnt; s++) {
		err = apply_step(node, &recipe->steps[s], elem_addrs, n_elems);
		if (err) {
			LOG_ERR("Apply failed at step %zu/%zu (err %d)", s + 1, recipe->step_cnt, err);
			return err;
		}
	}

	return 0;
}

int mesh_config_apply(struct bt_mesh_cdb_node *node, struct scenario_row *rows,
		      size_t n_rows, const char *name)
{
	struct scenario_row *row;
	uint8_t recipe_id;
	int err;

	k_mutex_lock(&scenario_mutex, K_FOREVER);
	row = scenario_find_row(node->uuid, name, rows, n_rows);
	if (!row) {
		k_mutex_unlock(&scenario_mutex);
		return -ENOENT;
	}

	recipe_id = scenario_row_peek_recipe_id(row);
	k_mutex_unlock(&scenario_mutex);
	err = mesh_config_apply_recipe(node, recipe_id);
	if (!err) {
		k_mutex_lock(&scenario_mutex, K_FOREVER);
		scenario_row_consume_recipe_id(row, recipe_id);
		k_mutex_unlock(&scenario_mutex);
	}

	return err;
}

static const char *const recipe_names[RECIPE_COUNT] = {
	[RECIPE_NONE] = "none",
	[RECIPE_LIGHT_CTRL_1] = "light_ctrl_1",
	[RECIPE_LIGHT_CTRL_2] = "light_ctrl_2",
	[RECIPE_DIMMER_1] = "dimmer_1",
	[RECIPE_DIMMER_2] = "dimmer_2",
	[RECIPE_LIGHT_SW_1] = "light_sw_1",
	[RECIPE_LIGHT_SW_2] = "light_sw_2",
	[RECIPE_ENOCEAN_BCAST] = "enocean_bcast",
};

const char *mesh_recipe_name(uint8_t recipe_id)
{
	if (recipe_id >= RECIPE_COUNT || !recipe_names[recipe_id]) {
		return "unknown";
	}
	return recipe_names[recipe_id];
}

void mesh_scenario_consume_recipe_id(const uint8_t uuid[16], const char *name,
				     struct scenario_row *rows, size_t n_rows,
				     uint8_t recipe_id)
{
	struct scenario_row *row = scenario_find_row(uuid, name, rows, n_rows);

	k_mutex_lock(&scenario_mutex, K_FOREVER);
	if (row != NULL) {
		scenario_row_consume_recipe_id(row, recipe_id);
	}
	k_mutex_unlock(&scenario_mutex);
}

uint8_t mesh_scenario_lookup_recipe_id(const uint8_t uuid[16], const char *name,
				       struct scenario_row *rows, size_t n_rows)
{
	struct scenario_row *row = scenario_find_row(uuid, name, rows, n_rows);
	uint8_t id;

	k_mutex_lock(&scenario_mutex, K_FOREVER);
	if (!row) {
		k_mutex_unlock(&scenario_mutex);
		return RECIPE_NONE;
	}

	id = scenario_row_peek_recipe_id(row);
	k_mutex_unlock(&scenario_mutex);

	if (id == RECIPE_NONE || id >= RECIPE_COUNT) {
		return RECIPE_NONE;
	}

	return id;
}
```

## src/mesh_recipes.c
```c
/*
 * Copyright (c) 2026 Nordic Semiconductor ASA
 *
 * SPDX-License-Identifier: LicenseRef-Nordic-5-Clause
 */

#include "mesh_recipes.h"

#include <zephyr/bluetooth/mesh.h>

/*
 * light_ctrl - two-element node.
 * elem[0]: Light Lightness Server - lightness from dimmers.
 * elem[1]: Light LC Server + Generic OnOff Server - on/off from switches.
 */
static const struct mesh_setup_step light_ctrl_1_steps[] = {
	NETKEY_ADD(NET_PRIMARY),
	APPKEY_ADD(NET_PRIMARY, APPKEY_IDX),

	BIND(0, SIG_MODEL(BT_MESH_MODEL_ID_LIGHT_LIGHTNESS_SRV), APPKEY_IDX),
	SUB(0, SIG_MODEL(BT_MESH_MODEL_ID_LIGHT_LIGHTNESS_SRV), GRP_1),

	BIND(1, SIG_MODEL(BT_MESH_MODEL_ID_LIGHT_LC_SRV), APPKEY_IDX),
	BIND(1, SIG_MODEL(BT_MESH_MODEL_ID_GEN_ONOFF_SRV), APPKEY_IDX),
	SUB(1, SIG_MODEL(BT_MESH_MODEL_ID_GEN_ONOFF_SRV), GRP_1),
};

static const struct mesh_setup_step light_ctrl_2_steps[] = {
	NETKEY_ADD(NET_PRIMARY),
	APPKEY_ADD(NET_PRIMARY, APPKEY_IDX),

	BIND(0, SIG_MODEL(BT_MESH_MODEL_ID_LIGHT_LIGHTNESS_SRV), APPKEY_IDX),
	SUB(0, SIG_MODEL(BT_MESH_MODEL_ID_LIGHT_LIGHTNESS_SRV), GRP_2),

	BIND(1, SIG_MODEL(BT_MESH_MODEL_ID_LIGHT_LC_SRV), APPKEY_IDX),
	BIND(1, SIG_MODEL(BT_MESH_MODEL_ID_GEN_ONOFF_SRV), APPKEY_IDX),
	SUB(1, SIG_MODEL(BT_MESH_MODEL_ID_GEN_ONOFF_SRV), GRP_2),
};

static const struct mesh_setup_step light_sw_1_steps[] = {
	NETKEY_ADD(NET_PRIMARY),
	APPKEY_ADD(NET_PRIMARY, APPKEY_IDX),

	BIND(0, SIG_MODEL(BT_MESH_MODEL_ID_GEN_ONOFF_CLI), APPKEY_IDX),
	/* light_sw_1: element 0 publishes to GRP_1 */
	PUB(0, SIG_MODEL(BT_MESH_MODEL_ID_GEN_ONOFF_CLI), APPKEY_IDX, GRP_1, PUB_TTL,
	    PUB_PERIOD_OFF, PUB_XMIT_1x100),
};

static const struct mesh_setup_step light_sw_2_steps[] = {
	NETKEY_ADD(NET_PRIMARY),
	APPKEY_ADD(NET_PRIMARY, APPKEY_IDX),

	BIND(0, SIG_MODEL(BT_MESH_MODEL_ID_GEN_ONOFF_CLI), APPKEY_IDX),
	/* light_sw_2: element 0 publishes to GRP_2 */
	PUB(0, SIG_MODEL(BT_MESH_MODEL_ID_GEN_ONOFF_CLI), APPKEY_IDX, GRP_2, PUB_TTL,
	    PUB_PERIOD_OFF, PUB_XMIT_1x100),
};

static const struct mesh_setup_step light_dimmer_1_steps[] = {
	NETKEY_ADD(NET_PRIMARY),
	APPKEY_ADD(NET_PRIMARY, APPKEY_IDX),

	BIND(0, SIG_MODEL(BT_MESH_MODEL_ID_GEN_ONOFF_CLI), APPKEY_IDX),
	PUB(0, SIG_MODEL(BT_MESH_MODEL_ID_GEN_LEVEL_CLI), APPKEY_IDX, GRP_1, PUB_TTL,
	    PUB_PERIOD_OFF, PUB_XMIT_1x100),

	BIND(0, SIG_MODEL(BT_MESH_MODEL_ID_GEN_LEVEL_CLI), APPKEY_IDX),
	PUB(0, SIG_MODEL(BT_MESH_MODEL_ID_SCENE_CLI), APPKEY_IDX, GRP_1, PUB_TTL,
	    PUB_PERIOD_OFF, PUB_XMIT_1x100),

	BIND(0, SIG_MODEL(BT_MESH_MODEL_ID_SCENE_CLI), APPKEY_IDX),
	PUB(0, SIG_MODEL(BT_MESH_MODEL_ID_GEN_ONOFF_CLI), APPKEY_IDX, GRP_1, PUB_TTL,
	    PUB_PERIOD_OFF, PUB_XMIT_1x100),
};

static const struct mesh_setup_step light_dimmer_2_steps[] = {
	NETKEY_ADD(NET_PRIMARY),
	APPKEY_ADD(NET_PRIMARY, APPKEY_IDX),

	BIND(0, SIG_MODEL(BT_MESH_MODEL_ID_GEN_ONOFF_CLI), APPKEY_IDX),
	PUB(0, SIG_MODEL(BT_MESH_MODEL_ID_GEN_LEVEL_CLI), APPKEY_IDX, GRP_2, PUB_TTL,
	    PUB_PERIOD_OFF, PUB_XMIT_1x100),

	BIND(0, SIG_MODEL(BT_MESH_MODEL_ID_GEN_LEVEL_CLI), APPKEY_IDX),
	PUB(0, SIG_MODEL(BT_MESH_MODEL_ID_SCENE_CLI), APPKEY_IDX, GRP_2, PUB_TTL,
	    PUB_PERIOD_OFF, PUB_XMIT_1x100),

	BIND(0, SIG_MODEL(BT_MESH_MODEL_ID_SCENE_CLI), APPKEY_IDX),
	PUB(0, SIG_MODEL(BT_MESH_MODEL_ID_GEN_ONOFF_CLI), APPKEY_IDX, GRP_2, PUB_TTL,
	    PUB_PERIOD_OFF, PUB_XMIT_1x100),
};

static const struct mesh_setup_step enocean_bcast_steps[] = {
	NETKEY_ADD(NET_PRIMARY),
	APPKEY_ADD(NET_PRIMARY, APPKEY_IDX),

	BIND(0, SIG_MODEL(BT_MESH_MODEL_ID_GEN_LEVEL_CLI), APPKEY_IDX),
	BIND(0, SIG_MODEL(BT_MESH_MODEL_ID_GEN_ONOFF_CLI), APPKEY_IDX),
	PUB(0, SIG_MODEL(BT_MESH_MODEL_ID_GEN_LEVEL_CLI), APPKEY_IDX, GRP_1, PUB_TTL,
	    PUB_PERIOD_OFF, PUB_XMIT_1x100),
	PUB(0, SIG_MODEL(BT_MESH_MODEL_ID_GEN_ONOFF_CLI), APPKEY_IDX, GRP_1, PUB_TTL,
	    PUB_PERIOD_OFF, PUB_XMIT_1x100),

	BIND(1, SIG_MODEL(BT_MESH_MODEL_ID_GEN_LEVEL_CLI), APPKEY_IDX),
	BIND(1, SIG_MODEL(BT_MESH_MODEL_ID_GEN_ONOFF_CLI), APPKEY_IDX),
	PUB(1, SIG_MODEL(BT_MESH_MODEL_ID_GEN_LEVEL_CLI), APPKEY_IDX, GRP_2, PUB_TTL,
	    PUB_PERIOD_OFF, PUB_XMIT_1x100),
	PUB(1, SIG_MODEL(BT_MESH_MODEL_ID_GEN_ONOFF_CLI), APPKEY_IDX, GRP_2, PUB_TTL,
	    PUB_PERIOD_OFF, PUB_XMIT_1x100),
};

/* Recipe registry - direct-indexed by enum mesh_recipe_id. Remember to update this list */
const struct mesh_recipe mesh_recipes[RECIPE_COUNT] = {
	[RECIPE_NONE] = { 0 },
	[RECIPE_LIGHT_CTRL_1] = RECIPE_ENTRY(light_ctrl_1_steps),
	[RECIPE_LIGHT_CTRL_2] = RECIPE_ENTRY(light_ctrl_2_steps),
	[RECIPE_DIMMER_1] = RECIPE_ENTRY(light_dimmer_1_steps),
	[RECIPE_DIMMER_2] = RECIPE_ENTRY(light_dimmer_2_steps),
	[RECIPE_LIGHT_SW_1] = RECIPE_ENTRY(light_sw_1_steps),
	[RECIPE_LIGHT_SW_2] = RECIPE_ENTRY(light_sw_2_steps),
	[RECIPE_ENOCEAN_BCAST] = RECIPE_ENTRY(enocean_bcast_steps),
};
```

## src/prov_cache.c
```c
/*
 * Copyright (c) 2026 Nordic Semiconductor ASA
 *
 * SPDX-License-Identifier: LicenseRef-Nordic-5-Clause
 */

#include <errno.h>
#include <limits.h>
#include <string.h>

#include <zephyr/kernel.h>
#include <zephyr/sys/util.h>

#include "prov_cache.h"

#define PROV_CACHE_MAX CONFIG_MESH_PROVISIONER_SCAN_UUID_CACHE_MAX
#define NAME_CAP (PROV_CACHE_NAME_BUF_SIZE - 1U)

struct prov_cache_entry {
	bt_addr_le_t addr;
	uint8_t uuid[16];
	char name[PROV_CACHE_NAME_BUF_SIZE];
	bool in_use;
	bool have_addr;
	bool have_uuid;
	bool have_name;
	bool scan_visible;
	int64_t last_attempt_ms;
};

static struct prov_cache_entry cache[PROV_CACHE_MAX];
static size_t evict_cursor;
static K_MUTEX_DEFINE(cache_mutex);

static void entry_clear(struct prov_cache_entry *entry)
{
	memset(entry, 0, sizeof(*entry));
	entry->last_attempt_ms = INT64_MIN;
}

static struct prov_cache_entry *find_by_addr_locked(const bt_addr_le_t *addr)
{
	for (size_t i = 0; i < ARRAY_SIZE(cache); i++) {
		if (!cache[i].in_use || !cache[i].have_addr) {
			continue;
		}

		if (bt_addr_le_cmp(&cache[i].addr, addr) == 0) {
			return &cache[i];
		}
	}

	return NULL;
}

static struct prov_cache_entry *find_by_uuid_locked(const uint8_t uuid[16])
{
	for (size_t i = 0; i < ARRAY_SIZE(cache); i++) {
		if (!cache[i].in_use || !cache[i].have_uuid) {
			continue;
		}

		if (memcmp(cache[i].uuid, uuid, sizeof(cache[i].uuid)) == 0) {
			return &cache[i];
		}
	}

	return NULL;
}

static bool evict_match(const struct prov_cache_entry *entry, int pass)
{
	switch (pass) {
	case 0:
		return !entry->scan_visible && !entry->have_name;
	case 1:
		return !entry->scan_visible;
	case 2:
		return true;
	default:
		return false;
	}
}

static struct prov_cache_entry *alloc_entry_locked(void)
{
	for (size_t i = 0; i < ARRAY_SIZE(cache); i++) {
		if (cache[i].in_use) {
			continue;
		}

		entry_clear(&cache[i]);
		cache[i].in_use = true;
		return &cache[i];
	}

	for (int pass = 0; pass < 3; pass++) {
		for (size_t offset = 0; offset < ARRAY_SIZE(cache); offset++) {
			size_t idx = (evict_cursor + offset) % ARRAY_SIZE(cache);

			if (!evict_match(&cache[idx], pass)) {
				continue;
			}

			evict_cursor = (idx + 1U) % ARRAY_SIZE(cache);
			entry_clear(&cache[idx]);
			cache[idx].in_use = true;
			return &cache[idx];
		}
	}

	return NULL;
}

static void name_set_locked(struct prov_cache_entry *entry, const uint8_t *data, size_t len)
{
	size_t n = MIN(len, (size_t)NAME_CAP);

	memcpy(entry->name, data, n);
	entry->name[n] = '\0';
	entry->have_name = true;
}

static bool retry_ready_locked(const struct prov_cache_entry *entry, int64_t now_ms,
			       int32_t retry_ms)
{
	if (!entry->in_use || !entry->have_uuid) {
		return false;
	}

	if (entry->last_attempt_ms != INT64_MIN &&
	    now_ms - entry->last_attempt_ms < (int64_t)retry_ms) {
		return false;
	}

	return true;
}

static size_t visible_index_locked(const struct prov_cache_entry *needle)
{
	size_t idx = 0;

	for (size_t i = 0; i < ARRAY_SIZE(cache); i++) {
		if (!cache[i].in_use || !cache[i].scan_visible) {
			continue;
		}

		if (&cache[i] == needle) {
			return idx;
		}

		idx++;
	}

	return idx;
}

int prov_cache_adv_uuid_seen(const bt_addr_le_t *addr, const uint8_t uuid[16])
{
	struct prov_cache_entry *by_addr;
	struct prov_cache_entry *by_uuid;
	struct prov_cache_entry *entry;

	k_mutex_lock(&cache_mutex, K_FOREVER);

	by_addr = find_by_addr_locked(addr);
	by_uuid = find_by_uuid_locked(uuid);

	if (by_addr != NULL && by_uuid != NULL && by_addr != by_uuid) {
		if (!by_uuid->have_name && by_addr->have_name) {
			memcpy(by_uuid->name, by_addr->name, sizeof(by_uuid->name));
			by_uuid->have_name = true;
		}
		if (by_addr->scan_visible) {
			by_uuid->scan_visible = true;
		}
		entry_clear(by_addr);
		by_addr->in_use = false;
		entry = by_uuid;
	} else if (by_uuid != NULL) {
		entry = by_uuid;
	} else if (by_addr != NULL) {
		entry = by_addr;
		if (entry->have_uuid &&
		    memcmp(entry->uuid, uuid, sizeof(entry->uuid)) != 0) {
			entry_clear(entry);
			entry->in_use = true;
		}
	} else {
		entry = alloc_entry_locked();
		if (entry == NULL) {
			k_mutex_unlock(&cache_mutex);
			return -ENOMEM;
		}
	}

	bt_addr_le_copy(&entry->addr, addr);
	memcpy(entry->uuid, uuid, sizeof(entry->uuid));
	entry->have_addr = true;
	entry->have_uuid = true;

	k_mutex_unlock(&cache_mutex);

	return 0;
}

bool prov_cache_scan_rsp_name_seen(const bt_addr_le_t *addr, const uint8_t *name, size_t len,
				   uint8_t uuid_out[16])
{
	struct prov_cache_entry *entry;
	bool have_uuid = false;

	k_mutex_lock(&cache_mutex, K_FOREVER);

	entry = find_by_addr_locked(addr);
	if (entry != NULL) {
		name_set_locked(entry, name, len);
		if (entry->have_uuid) {
			memcpy(uuid_out, entry->uuid, sizeof(entry->uuid));
			have_uuid = true;
		}
	}

	k_mutex_unlock(&cache_mutex);

	return have_uuid;
}

int prov_cache_ensure_uuid(const uint8_t uuid[16])
{
	struct prov_cache_entry *entry;

	k_mutex_lock(&cache_mutex, K_FOREVER);

	entry = find_by_uuid_locked(uuid);
	if (entry == NULL) {
		entry = alloc_entry_locked();
		if (entry == NULL) {
			k_mutex_unlock(&cache_mutex);
			return -ENOMEM;
		}

		memcpy(entry->uuid, uuid, sizeof(entry->uuid));
		entry->have_uuid = true;
	}

	k_mutex_unlock(&cache_mutex);

	return 0;
}

bool prov_cache_lookup_name(const uint8_t uuid[16], char *name, size_t name_len)
{
	struct prov_cache_entry *entry;
	bool found = false;

	if (name_len == 0U) {
		return false;
	}

	k_mutex_lock(&cache_mutex, K_FOREVER);

	entry = find_by_uuid_locked(uuid);
	if (entry != NULL && entry->have_name) {
		strncpy(name, entry->name, name_len - 1U);
		name[name_len - 1U] = '\0';
		found = true;
	}

	k_mutex_unlock(&cache_mutex);

	return found;
}

bool prov_cache_maybe_mark_visible(const uint8_t uuid[16], size_t *visible_idx)
{
	struct prov_cache_entry *entry;
	bool marked = false;

	k_mutex_lock(&cache_mutex, K_FOREVER);

	entry = find_by_uuid_locked(uuid);
	if (entry != NULL && entry->have_name && !entry->scan_visible) {
		entry->scan_visible = true;
		if (visible_idx != NULL) {
			*visible_idx = visible_index_locked(entry);
		}
		marked = true;
	}

	k_mutex_unlock(&cache_mutex);

	return marked;
}

void prov_cache_mark_all_ready_visible(void)
{
	k_mutex_lock(&cache_mutex, K_FOREVER);

	for (size_t i = 0; i < ARRAY_SIZE(cache); i++) {
		if (!cache[i].in_use || !cache[i].have_uuid || !cache[i].have_name) {
			continue;
		}

		cache[i].scan_visible = true;
	}

	k_mutex_unlock(&cache_mutex);
}

size_t prov_cache_visible_count(void)
{
	size_t count = 0;

	k_mutex_lock(&cache_mutex, K_FOREVER);

	for (size_t i = 0; i < ARRAY_SIZE(cache); i++) {
		if (cache[i].in_use && cache[i].scan_visible) {
			count++;
		}
	}

	k_mutex_unlock(&cache_mutex);

	return count;
}

int prov_cache_visible_uuid_by_index(size_t idx, uint8_t uuid[16])
{
	size_t visible_idx = 0;
	int err = -ENOENT;

	k_mutex_lock(&cache_mutex, K_FOREVER);

	for (size_t i = 0; i < ARRAY_SIZE(cache); i++) {
		if (!cache[i].in_use || !cache[i].scan_visible) {
			continue;
		}

		if (visible_idx == idx) {
			memcpy(uuid, cache[i].uuid, sizeof(cache[i].uuid));
			err = 0;
			break;
		}

		visible_idx++;
	}

	k_mutex_unlock(&cache_mutex);

	return err;
}

bool prov_cache_should_auto_attempt(const uint8_t uuid[16], int64_t now_ms, int32_t retry_ms)
{
	struct prov_cache_entry *entry;
	bool should_attempt = false;

	k_mutex_lock(&cache_mutex, K_FOREVER);

	entry = find_by_uuid_locked(uuid);
	if (entry != NULL) {
		should_attempt = retry_ready_locked(entry, now_ms, retry_ms);
	}

	k_mutex_unlock(&cache_mutex);

	return should_attempt;
}

bool prov_cache_find_next_auto_candidate(size_t *cursor, int64_t now_ms, int32_t retry_ms,
					 uint8_t uuid[16])
{
	bool found = false;

	k_mutex_lock(&cache_mutex, K_FOREVER);

	for (size_t i = *cursor; i < ARRAY_SIZE(cache); i++) {
		if (!retry_ready_locked(&cache[i], now_ms, retry_ms)) {
			continue;
		}

		memcpy(uuid, cache[i].uuid, sizeof(cache[i].uuid));
		*cursor = i + 1U;
		found = true;
		break;
	}

	k_mutex_unlock(&cache_mutex);

	return found;
}

void prov_cache_mark_attempt(const uint8_t uuid[16], int64_t now_ms)
{
	struct prov_cache_entry *entry;

	k_mutex_lock(&cache_mutex, K_FOREVER);

	entry = find_by_uuid_locked(uuid);
	if (entry != NULL) {
		entry->last_attempt_ms = now_ms;
	}

	k_mutex_unlock(&cache_mutex);
}

void prov_cache_on_configuration_success(const uint8_t uuid[16])
{
	struct prov_cache_entry *entry;

	k_mutex_lock(&cache_mutex, K_FOREVER);

	entry = find_by_uuid_locked(uuid);
	if (entry != NULL) {
		entry_clear(entry);
		entry->in_use = false;
	}

	k_mutex_unlock(&cache_mutex);
}
```
